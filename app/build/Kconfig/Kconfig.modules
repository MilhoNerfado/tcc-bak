## app/build/Kconfig/Kconfig.modules
```kconfig
menu "example-application (/home/milho/Repos/zephyr/example-application)"
osource "/home/milho/Repos/zephyr/example-application/Kconfig"
config ZEPHYR_EXAMPLE_APPLICATION_MODULE
	bool
	default y
endmenu
menu "cmsis (/home/milho/Repos/zephyr/modules/hal/cmsis)"
osource "$(ZEPHYR_CMSIS_KCONFIG)"
config ZEPHYR_CMSIS_MODULE
	bool
	default y
endmenu
menu "hal_nordic (/home/milho/Repos/zephyr/modules/hal/nordic)"
osource "$(ZEPHYR_HAL_NORDIC_KCONFIG)"
config ZEPHYR_HAL_NORDIC_MODULE
	bool
	default y
endmenu
config ZEPHYR_STM32_MODULE
   bool
   default y
```

## app/build/Kconfig/Kconfig.shield
```kconfig
osource "/home/milho/Repos/zephyr/example-application/boards/shields/*/Kconfig.shield"
```

## app/build/Kconfig/arch/Kconfig
```kconfig
# Load arch Kconfig descriptions.
osource "/home/milho/Repos/zephyr/zephyr/arch/x86/Kconfig"
osource "/home/milho/Repos/zephyr/zephyr/arch/xtensa/Kconfig"
osource "/home/milho/Repos/zephyr/zephyr/arch/sparc/Kconfig"
osource "/home/milho/Repos/zephyr/zephyr/arch/riscv/Kconfig"
osource "/home/milho/Repos/zephyr/zephyr/arch/posix/Kconfig"
osource "/home/milho/Repos/zephyr/zephyr/arch/nios2/Kconfig"
osource "/home/milho/Repos/zephyr/zephyr/arch/mips/Kconfig"
osource "/home/milho/Repos/zephyr/zephyr/arch/arm64/Kconfig"
osource "/home/milho/Repos/zephyr/zephyr/arch/arm/Kconfig"
osource "/home/milho/Repos/zephyr/zephyr/arch/arc/Kconfig"
```

## drivers/mutex/Kconfig
```kconfig
# Copyright (c) 2024 Nordic Semiconductor ASA
# SPDX-License-Identifier: Apache-2.0

menuconfig MUTEX
	bool "Mutex device drivers"
	help
	  This option enables the blink custom driver class.

if MUTEX

config RELAY_LEN
	int "Relay length"
	default 1
	help
	  Bit length resolution for the mutex

module = MUTEX
module-str = mutex
source "subsys/logging/Kconfig.template.log_config"

endif # BLINK
```
